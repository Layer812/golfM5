// SPDX-License-Identifier: MIT
// Copyright (c) 2026 Layer812
// BALL'S EYE GOLF — standalone M5Stack StopWatch application.
// Hardware startup is owned by src/main.cpp; this file owns only the game.
// Display/PMIC/touch initialization is performed once through M5Unified.
#include <Arduino.h>
#include <M5Unified.h>
#include <M5GFX.h>
#include "GamePhysics.hpp"
#include "GameControls.hpp"
#include <math.h>
#include <stdio.h>
#include <esp_heap_caps.h>

using namespace beg;
namespace {
Game game;
enum class GameMode : uint8_t { TOURNAMENT, LONG_DRIVE };
GameMode mode = GameMode::TOURNAMENT;
int currentHole = 0;
int holeScores[kHoleCount] = {};
int completedStrokes = 0, completedPar = 0;
bool tournamentFinished = false;
// Long drive: three single-shot attempts. Distance is measured at rest;
// water hazard means a void attempt, not an arbitrary ranking penalty.
static constexpr int DRIVE_ATTEMPTS = 3;
float driveDistances[DRIVE_ATTEMPTS] = {};
float bestDrive = 0;
float driveTeeX = 0, driveTeeZ = 0;
int driveAttempt = 0;
bool driveResult = false;
bool driveFinished = false;
bool driveTouchWasDown = false;

// STAR VOYAGER R16F5 presents the rendered frame from a 16-bit PSRAM
// canvas, rather than driving hundreds of tiny AMOLED QSPI transactions.
// Preserve precisely the known-good M5.begin(cfg) + direct boot splash.
static M5Canvas scene(&M5.Display);
static bool haveScene = false;
static constexpr int SCENE_SIDE = 466;

bool displayReady = false;
int screenW = 466;
int screenH = 466;
float unitScale = 1;
uint32_t lastPhysicsUs = 0, lastDraw = 0;
float physicsCarry = 0.0f;
State lastDrawnState = State::READY;
bool forceDraw = true;
uint32_t windRound = 0;
// Shot/landing feedback is part of golf rendering, not StopWatch initialization.
uint32_t lastShotAtMs = 0, lastLandingAtMs = 0;
float lastShotPower = 0.0f, lastShotImpact = 0.0f;
uint32_t lastWaterResetAtMs = 0;
bool menuOpen = false;
bool menuTouchWasDown = false;
bool settingsSound = true;
bool settingsVibration = true;
int settingsAimStep = 5;
bool settingsAutoAimToCup = true; // Default is the existing R12 FIX3 behaviour.
// Shared row centres for menu rendering AND touch hit detection.
static constexpr int kMenuRowY[7] = {135,184,233,282,331,380,427};
static constexpr int kMenuRowHalf = 20;
int menuRowAt(float x,float y) {
    if(x<107 || x>359) return -1;
    for(int i=0;i<7;++i) {
        if(y>=kMenuRowY[i]-kMenuRowHalf && y<=kMenuRowY[i]+kMenuRowHalf) return i;
    }
    return -1;
}
TouchGesture gesture;
static constexpr float FIXED_DT = 1.0f / 120.0f;
static constexpr float TAU = 6.283185307179586f;
static constexpr int DISC_STEPS = 20;
float discSin[DISC_STEPS], discCos[DISC_STEPS];
// Static worldspace fairway ribbon vertices, cached once at startup.
struct FairwayRow { float x,w; };
static constexpr int FAIRWAY_START = -10, FAIRWAY_END = 550, FAIRWAY_STEP = 5;
static constexpr int FAIRWAY_ROWS = (FAIRWAY_END-FAIRWAY_START)/FAIRWAY_STEP+1;
FairwayRow fairway[FAIRWAY_ROWS];
void refreshFairway() {
    for(int i=0;i<FAIRWAY_ROWS;++i) {
        float z=FAIRWAY_START+(float)(FAIRWAY_STEP*i);
        float x,w;
        game.fairwayAt(z,x,w);
        fairway[i]={x,w};
    }
}
void precomputeScene() {
    for(int i=0;i<DISC_STEPS;++i) {
        float a=TAU*(float)i/DISC_STEPS;
        discSin[i]=sinf(a); discCos[i]=cosf(a);
    }
    refreshFairway();
}

uint32_t vibrationUntil = 0, pendingToneAt = 0;
// Avoid touching the IO expander vibration output while the AMOLED is starting.
// The first haptic write happens only after an actual shot or collision.
bool vibrationEnabled = false;
bool speakerVolumeConfigured = false;
// The first queued audio used to disappear. Prime the speaker with silence
// After the initial visible title draw, retry a rejected PCM queue.
static const int16_t kSpeakerWarmupSilence[2048] = {};
const int16_t* queuedClubSound = nullptr;
size_t queuedClubFrames = 0;
uint8_t queuedClubRetries = 0;
uint32_t nextClubRetryMs = 0;
uint16_t pendingToneFreq = 0, pendingToneDuration = 0;


int S(float v) { return (int)lroundf(v * unitScale); }
int clipInt(float f) {
    if (f < -1900) return -1900;
    if (f > 1900) return 1900;
    return (int)lroundf(f);
}
uint16_t rgb(int r, int g, int b) {
    r=(int)clampf((float)r,0,255);
    g=(int)clampf((float)g,0,255);
    b=(int)clampf((float)b,0,255);
    return (uint16_t)(((r & 248) << 8) | ((g & 252) << 3) | (b >> 3));
}
const uint16_t cWhite = 0xffff;
const uint16_t cGold = 0xffc0;
const uint16_t cBlack = 0x0000;

// Three original pre-rendered 16-bit mono PCM golf-club impacts, 22,050 Hz.
// Kept in flash as immutable arrays: no file system, boot-path, or PSRAM changes.
// Physically modelled attack/noise/inharmonic face decay (not licensed recordings).
static constexpr uint32_t kClubImpactSampleRate = 22050;
alignas(4) static const int16_t kDriverImpactPCM[] = {
    19, 1517, -553, 651, 11883, 3873, -5717, 11255, 16623, 2695, 6316, 8680, -519, -4798, -2573, -8407,
    -5773, 11285, -2095, -7338, -457, -11797, -11544, -10446, -17992, -16641, -11980, -16148, -12043, -7153, -10126, -7126,
    -6176, -3078, -9451, -13538, -2468, -13042, -22206, -14324, -16981, -23399, -31129, -29711, -23607, -29544, -30896, -28175,
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    -5, -3, -1, 2, 2, 2, 1, 0, 0, 0, 0, 0, 0, 0,
};
alignas(4) static const int16_t kSpoonImpactPCM[] = {
    1591, 3288, -1483, 7485, 2268, -9651, 3933, -639, -910, 9770, 9163, 11183, 15112, 15298, 6075, -2007,
    -4003, -5000, -8576, -4690, 3953, 4157, 4292, 4165, -1760, -2716, 4472, 4030, 2188, 7259, 3144, 7347,
    15013, 8051, 13544, 17560, 13581, 13093, 11105, 9009, 3844, 812, -1396, -3386, -4983, -7944, -8793, -7893,
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    1, 1, 0, 0, 0, 0,
};
alignas(4) static const int16_t kPutterImpactPCM[] = {
    -25, 1076, 4288, 1748, 253, 9382, 7988, -1848, -1580, 7993, 13762, 1070, -8030, 6110, 8061, -1857,
    -4787, -9385, -12546, -10671, -8946, -3128, 2996, -759, -5385, -5671, -8006, -13036, -12122, -10334, -11539, -11167,
    -11506, -9695, -6863, -5123, -2719, 672, 792, -3112, 69, 7001, 5192, 824, -1243, -750, -1859, -4392,
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    2, 2, 1, 1, 0, -1, -1, -1, -1, 0, 0, 0, 0, 0, 0,
};


void buzz(uint8_t strength, uint32_t durationMs) {
    if (!settingsVibration) return;
    M5.Power.setVibration(strength);
    vibrationEnabled = true;
    vibrationUntil = millis() + durationMs;
}
void sound(uint16_t hz, uint32_t ms) {
    if (!settingsSound) return;
    if (!speakerVolumeConfigured) {
        M5.Speaker.setVolume(100);
        speakerVolumeConfigured = true;
    }
    M5.Speaker.tone(hz, ms);
}
void afterTone(uint16_t hz, uint16_t ms, uint32_t delayMs) {
    pendingToneAt = millis() + delayMs;
    pendingToneFreq = hz;
    pendingToneDuration = ms;
}
// Speaker and panel setup are kept separate. Called after our own first
// display drawString and the game's initial screen render.
void primeGolfSpeaker() {
    if (!settingsSound) return;
    M5.Speaker.setVolume(112);
    speakerVolumeConfigured = true;
    // This silent playback wakes the audio path without replacing a real hit.
    (void)M5.Speaker.playRaw(kSpeakerWarmupSilence,
        sizeof(kSpeakerWarmupSilence)/sizeof(kSpeakerWarmupSilence[0]),
        kClubImpactSampleRate, false, 1, 0, true);
}
// M5Unified 0.2.21's int16_t playRaw returns bool on queue acceptance.
// Never drop the first driver impact silently if the speaker isn't ready.
void playClubImpact(const int16_t* data, size_t frameCount) {
    if (!settingsSound) return;
    if (!speakerVolumeConfigured) {
        M5.Speaker.setVolume(112);
        speakerVolumeConfigured = true;
    }
    queuedClubSound = nullptr;
    queuedClubFrames = 0;
    queuedClubRetries = 0;
    const bool ok=M5.Speaker.playRaw(data, frameCount, kClubImpactSampleRate,
                                     false, 1, 0, true);
    if (!ok) {
        queuedClubSound = data;
        queuedClubFrames = frameCount;
        queuedClubRetries = 4;
        nextClubRetryMs = millis()+25;
        Serial.println("BEG_R11 PCM queue rejected; retrying");
    }
}
void shotFX(bool putt, bool firstLongShot) {
    if (putt) {
        playClubImpact(kPutterImpactPCM,
                       sizeof(kPutterImpactPCM)/sizeof(kPutterImpactPCM[0]));
        buzz(90, 45);
    } else if (firstLongShot) {
        playClubImpact(kDriverImpactPCM,
                       sizeof(kDriverImpactPCM)/sizeof(kDriverImpactPCM[0]));
        buzz(210, 100);
    } else {
        playClubImpact(kSpoonImpactPCM,
                       sizeof(kSpoonImpactPCM)/sizeof(kSpoonImpactPCM[0]));
        buzz(210, 100);
    }
}
void landingFX() {
    sound(235, 80);
    buzz(125, 70);
}
void cupFX() {
    sound(1050, 55);
    afterTone(530, 165, 70);
    buzz(190, 130);
}
void updateFX() {
    uint32_t now=millis();
    if (queuedClubSound && (int32_t)(now-nextClubRetryMs)>=0) {
        if (!settingsSound) {
            queuedClubSound=nullptr;
        } else if (M5.Speaker.playRaw(queuedClubSound, queuedClubFrames,
                                     kClubImpactSampleRate,false,1,0,true)) {
            queuedClubSound=nullptr;
        } else if (queuedClubRetries>1) {
            --queuedClubRetries;
            nextClubRetryMs=now+35;
        } else {
            queuedClubSound=nullptr;
            // Fallback is audible even if the PCM queue couldn't initialize.
            M5.Speaker.tone(950,90);
            Serial.println("BEG_R11 PCM unavailable; tone fallback");
        }
    }
    if (vibrationUntil && (int32_t)(now - vibrationUntil) >= 0) {
        M5.Power.setVibration(0);
        vibrationEnabled = false;
        vibrationUntil=0;
    }
    if (pendingToneAt && (int32_t)(now - pendingToneAt) >= 0) {
        sound(pendingToneFreq,pendingToneDuration);
        pendingToneAt=0;
    }
}

struct Point { int x=0,y=0; bool ok=false; float depth=0; };
struct Camera {
    float x=0,z=0,h=.6f;
    float fX=0,fZ=1,rX=1,rZ=0;
    float focal=425, horizon=200;
    explicit Camera() {
        x=game.x; z=game.z;
        h=game.y+.62f;
        fX=game.aimX; fZ=game.aimZ;
        if (game.state == State::HOLED) h=.12f;
        rX=fZ; rZ=-fX;
        focal=screenW*.86f;
        // Slight view recoil in the air; no fast roll/pitch camera rotations.
        float airborne = game.state==State::AIRBORNE ? clampf(game.vy*.23f,-5,5) : 0;
        horizon=screenH*.405f+airborne;
    }
    Point project(float wx,float wz,float wy=0) const {
        float dx=wx-x, dz=wz-z;
        float d=dx*fX+dz*fZ;
        Point p;
        if (d < .85f) return p;
        p.depth=d;
        p.x=clipInt(clampf(screenW*.5f + (dx*rX+dz*rZ)*focal/d,
                             -110,screenW+110));
        p.y=clipInt(clampf(horizon + (h-wy)*focal/d,
                             -110,screenH+110));
        p.ok=true;
        return p;
    }
};

template<class D>
void triangle(D& d,Point a,Point b,Point c,uint16_t color) {
    if (a.ok && b.ok && c.ok)
        d.fillTriangle(a.x,a.y,b.x,b.y,c.x,c.y,color);
}
template<class D>
void groundDisc(D &d,const Camera &cam,float x,float z,float radius,uint16_t col) {
    Point mid=cam.project(x,z);
    if (!mid.ok) return;
    // Circle directions are cached; four discs used to require 160 trig calls
    // for every frame even though their world positions never change.
    for(int k=0;k<DISC_STEPS;++k) {
        int n=(k+1)%DISC_STEPS;
        Point pa=cam.project(x+radius*discCos[k],z+radius*discSin[k]);
        Point pb=cam.project(x+radius*discCos[n],z+radius*discSin[n]);
        triangle(d,mid,pa,pb,col);
    }
}
template<class D>
void groundEllipse(D &d, const Camera &cam, const HazardEllipse &h, float extra, uint16_t color) {
    Point mid=cam.project(h.x,h.z);
    if (!mid.ok) return;
    for (int k=0;k<DISC_STEPS;++k) {
        int n=(k+1)%DISC_STEPS;
        Point pa=cam.project(h.x+(h.rx+extra)*discCos[k],h.z+(h.rz+extra)*discSin[k]);
        Point pb=cam.project(h.x+(h.rx+extra)*discCos[n],h.z+(h.rz+extra)*discSin[n]);
        triangle(d,mid,pa,pb,color);
    }
}

template<class D>
void tree(D &d,const Camera &cam,float wx,float wz,uint16_t shade) {
    Point base=cam.project(wx,wz,0);
    Point tip=cam.project(wx,wz,7.5f);
    if (!base.ok || !tip.ok || base.y < -30 || tip.y>screenH+80) return;
    int r=(int)clampf((5.0f*cam.focal)/base.depth,2,78);
    if (r<3) return;
    int trunk=(int)clampf((1.0f*cam.focal)/base.depth,1,17);
    d.fillRect(base.x-trunk/2,tip.y+r/2,trunk,base.y-tip.y-r/2,rgb(83,64,35));
    d.fillTriangle(base.x-r,tip.y+r,base.x+r,tip.y+r,tip.x,tip.y-r/2,shade);
    d.fillTriangle(base.x-(int)(r*.8f),tip.y+(int)(r*.2f),
                   base.x+(int)(r*.8f),tip.y+(int)(r*.2f),tip.x,tip.y-r,
                   rgb(24,92,45));
}

// After falling through the lip, the camera looks up from INSIDE the cup.
// Draw a visible circular sky opening, grass, earthen walls and a flagpole.
template<class D>
void drawCupInterior(D& d) {
    const int cx=screenW/2, cy=S(215);
    d.fillScreen(rgb(13, 17, 13));
    // Dark inner earth, rim and grass seen from underneath.
    d.fillCircle(cx,cy,S(197),rgb(37,37,26));
    d.fillCircle(cx,cy,S(182),rgb(67,62,40));
    d.fillCircle(cx,cy,S(169),rgb(29,79,43));
    d.fillCircle(cx,cy,S(154),rgb(13,31,35));
    // Bright sky opening and a softly graded blue sky inside the lip.
    for(int radius=152;radius>0;radius-=12) {
        float t=1.0f-(float)radius/152.0f;
        d.fillCircle(cx,cy,S(radius),rgb(75+int(58*t),158+int(62*t),216+int(32*t)));
    }
    d.fillCircle(cx-S(58),cy-S(61),S(21),rgb(249,238,171));
    // Clouds, entirely inside sky opening.
    d.fillEllipse(cx-S(60),cy+S(6),S(43),S(15),rgb(232,246,244));
    d.fillEllipse(cx-S(39),cy-S(5),S(34),S(17),rgb(246,249,248));
    d.fillEllipse(cx-S(83),cy-S(1),S(25),S(11),rgb(246,249,248));
    d.fillEllipse(cx+S(73),cy-S(58),S(32),S(10),rgb(237,248,245));
    d.fillEllipse(cx+S(55),cy-S(65),S(20),S(10),rgb(249,250,245));
    // Tiny silhouette of the flagstick at the outer lip, no ball-eye spinning.
    d.drawLine(cx+S(101),cy-S(125),cx+S(106),cy-S(159),rgb(247,248,235));
    d.fillTriangle(cx+S(106),cy-S(159),cx+S(133),cy-S(149),
                   cx+S(105),cy-S(145),rgb(235,83,69));
    // Dappled grass at the opening edge.
    for(int i=0;i<DISC_STEPS;++i) {
        float rr=156.0f+float(i%3)*2.0f;
        int x1=cx+S(rr*discCos[i]), y1=cy+S(rr*discSin[i]);
        int x2=cx+S((rr-8.0f)*discCos[i]);
        int y2=cy+S((rr-8.0f)*discSin[i]);
        d.drawLine(x1,y1,x2,y2,rgb(100,163,66));
    }
}

// View from the sinking ball: the player is below the pond, looking up
// through the shrinking water surface to the sky. No camera spin/replay.
template<class D>
void drawUnderwater(D& d) {
    const float progress=clampf(game.waterClock/Game::WATER_VIEW_SECONDS,0.f,1.f);
    for(int y=0;y<screenH;y+=8) {
        float t=float(y)/float(screenH);
        d.fillRect(0,y,screenW,8,rgb(4+int(9*t),45-int(24*t),61-int(22*t)));
    }
    const int cx=S(233), cy=S(205+int(progress*24));
    const int rx=S(191.0f-progress*88.0f), ry=S(137.0f-progress*69.0f);
    d.fillEllipse(cx,cy,rx+S(14),ry+S(13),rgb(18,95,104));
    d.fillEllipse(cx,cy,rx+S(6),ry+S(6),rgb(39,143,159));
    d.fillEllipse(cx,cy,rx,ry,rgb(47+int(progress*13),149+int(progress*19),183+int(progress*14)));
    // Surface caustics and refracted daylight, seen through blue water.
    for(int i=1;i<=4;++i) {
        int rrx=(rx*i)/5, rry=(ry*i)/5;
        d.drawEllipse(cx,cy,rrx,rry,rgb(86+i*13,192+i*11,207+i*9));
    }
    d.fillCircle(cx-S(35),cy-S(28),S(13),rgb(191,226,219));
    for(int i=0;i<12;++i) {
        // Rising bubbles move upward while the observer sinks.
        float drift=fmodf(game.waterClock*(12.0f+float(i%5)*3.0f)+float(i*37),340.0f);
        int px=S(55+(i*73)%360), py=S(425.0f-drift);
        int radius=S(3+(i%3)*2);
        d.drawCircle(px,py,radius,rgb(91,184,200));
        if (i%3==0) d.fillCircle(px-S(1),py-S(1),S(2),rgb(166,223,228));
    }
    for (int i=0;i<7;++i) {
        int x=S(30+i*67);
        d.drawLine(x,screenH,x+S((i%2)?11:-13),S(360),rgb(14,70,65));
    }
}

template<class D>
void drawRavine(D &d, const Camera &cam) {
    const HoleLayout &c=game.course();
    if(c.terrain!=RAVINE) return;
    const float farZ=c.ravineEnd, nearZ=c.ravineStart;
    const float xl=-36.f, xr=36.f;
    Point a=cam.project(xl,farZ),b=cam.project(xr,farZ);
    Point l=cam.project(xl,nearZ),r=cam.project(xr,nearZ);
    triangle(d,a,b,l,rgb(39,46,39));triangle(d,b,l,r,rgb(31,38,38));
    Point lowA=cam.project(xl,farZ,-7.f),lowB=cam.project(xr,farZ,-7.f);
    triangle(d,a,b,lowA,rgb(89,81,61));triangle(d,b,lowA,lowB,rgb(64,59,52));
    if(l.ok&&r.ok) d.drawLine(l.x,l.y,r.x,r.y,rgb(189,168,126));
    if(a.ok&&b.ok) d.drawLine(a.x,a.y,b.x,b.y,rgb(188,158,109));
}

template<class D>
void drawRavineFall(D &d) {
    // Canyon opening shrinks overhead while the ball falls below the lip.
    const float p=clampf(game.waterClock/Game::WATER_VIEW_SECONDS,0.f,1.f);
    d.fillScreen(rgb(38,38,36));
    for(int i=0;i<13;++i) {
        int w=S(218-i*11-p*42),h=S(198-i*10-p*37);
        if(w<=0||h<=0) break;
        d.fillEllipse(S(233),S(210+p*30),w,h,
          i<5?rgb(101-i*9,91-i*7,67-i*4):rgb(42+i*4,92+i*7,115+i*6));
    }
    d.fillCircle(S(172),S(149),S(18),rgb(236,227,176));
}

template<class D>
void drawWorld(D& d) {
    if(game.state==State::HOLED) { drawCupInterior(d); return; }
    if(game.state==State::SINKING) { if(game.ravineSink)drawRavineFall(d);else drawUnderwater(d); return; }
    const Camera cam;
    const int hy=(int)cam.horizon;
    // Each hole has a visually distinct environment, in addition to its
    // individually designed fairway, obstacles, and cup placement.
    const int theme=game.course().terrain;
    for(int y=0; y<hy; y+=7) {
        float t=(float)y/(hy>1?hy:1);
        d.fillRect(0,y,screenW,7,
            theme==WOODS?rgb(49+54*t,111+72*t,159+46*t):
            theme==RAVINE?rgb(76+60*t,134+65*t,174+47*t):
            theme==SAND?rgb(93+57*t,159+49*t,212+35*t):
            rgb(38+84*t,133+67*t,205+40*t));
    }
    d.fillCircle(S(334), S(112), S(24), rgb(255,244,184));
    for(int x=0;x<screenW+80;x+=55) {
        int yy=hy-(int)(22*unitScale + 10*unitScale*sinf((float)x*.025f));
        d.fillTriangle(x-45,hy+2,x+35,hy+2,x,yy,rgb(65,132,133));
    }
    d.fillRect(0,hy,screenW,screenH-hy,
        theme==SAND?rgb(99,127,64):(theme==WOODS?rgb(29,87,43):rgb(48,125,61)));
    for (int y=hy;y<screenH;y+=12) {
        int lum=15+(y-hy)*24/screenH;
        d.fillRect(0,y,screenW,5,theme==SAND?rgb(109+lum,126+lum,66+lum/2):
            theme==WOODS?rgb(25+lum,81+lum,34+lum/2):rgb(42+lum,105+lum,48+lum/2));
    }
    // Near-to-far ribbon segments in world coordinates, painted far-to-near.
    // Precomputed fairway rows; sorted from far to near for either heading.
    // When the hole is sideways, retain the green base rather than divide
    // by an almost-zero camera Z component.
    if (fabsf(cam.fZ) > .07f) for(int i=0;i<FAIRWAY_ROWS-1;++i) {
        int farIdx=cam.fZ>=0 ? FAIRWAY_ROWS-1-i : i;
        int nearIdx=cam.fZ>=0 ? farIdx-1 : farIdx+1;
        float zf=FAIRWAY_START+(float)(FAIRWAY_STEP*farIdx);
        float zn=FAIRWAY_START+(float)(FAIRWAY_STEP*nearIdx);
        float farDepth=(zf-cam.z)*cam.fZ;
        if (farDepth <= .95f) continue;
        float nearDepth=(zn-cam.z)*cam.fZ;
        float xf=fairway[farIdx].x, wf=fairway[farIdx].w;
        float xn=fairway[nearIdx].x, wn=fairway[nearIdx].w;
        if (nearDepth < .95f) {
            float t=clampf((.95f-nearDepth)/(farDepth-nearDepth),0,1);
            zn += (zf-zn)*t;
            xn += (xf-xn)*t;
            wn += (wf-wn)*t;
        }
        Point a=cam.project(xf-wf,zf), b=cam.project(xf+wf,zf);
        Point c=cam.project(xn-wn,zn), e=cam.project(xn+wn,zn);
        uint16_t color=(i%2) ? rgb(76,178,73) : rgb(70,169,68);
        triangle(d,a,b,c,color);
        triangle(d,b,c,e,color);
        if (i%2) {
            Point m0=cam.project(xf,zf),m1=cam.project(xn,zn);
            if(m0.ok && m1.ok) d.drawLine(m0.x,m0.y,m1.x,m1.y,rgb(111,192,80));
        }
    }
    // Deep ravine crosses Hole 5, with matching physics boundary.
    drawRavine(d,cam);
    // Bunkers and ponds use the exact same ellipses as ball collision.
    for (int i=0;i<game.bunkerCount();++i) {
        const HazardEllipse b=game.bunker(i);
        groundEllipse(d,cam,b,1.5f,rgb(148,133,93));
        groundEllipse(d,cam,b,0.0f,rgb(225,199,126));
    }
    for (int i=0;i<game.pondCount();++i) {
        const HazardEllipse p=game.pond(i);
        groundEllipse(d,cam,p,2.1f,rgb(157,185,124));
        groundEllipse(d,cam,p,0.0f,rgb(21,99,148));
        groundEllipse(d,cam,p,-1.7f,rgb(31,138,181));
    }
    groundDisc(d,cam,game.holeX,game.holeZ,18.2f,rgb(53,185,84));
    groundDisc(d,cam,game.holeX,game.holeZ,11.0f,rgb(61,197,89));
    // Each hole has independently placed trees; the same tree trunks
    // interact with the moving ball in GamePhysics.hpp.
    for(int i=0;i<game.treeCount();++i) {
        const TreeMark t=game.treeAt(i);
        if(cam.project(t.x,t.z).ok)
            tree(d,cam,t.x,t.z,rgb(20,114,48));
    }
    Point cup=cam.project(game.holeX,game.holeZ,.02f);
    if(cup.ok) {
        int r=(int)clampf(120.0f/cup.depth,2,27);
        d.fillEllipse(cup.x,cup.y,r,(int)clampf(r*.48f,1,12),rgb(22,57,30));
    }
    Point p0=cam.project(game.holeX,game.holeZ,0);
    Point p1=cam.project(game.holeX,game.holeZ,4.2f);
    if(p0.ok && p1.ok) {
        d.drawLine(p0.x,p0.y,p1.x,p1.y,rgb(240,239,225));
        int flag=(int)clampf(1.2f*cam.focal/p1.depth,4,35);
        d.fillTriangle(p1.x,p1.y,p1.x+flag,p1.y+flag/3,
                       p1.x,p1.y+flag/2,rgb(235,62,57));
    }
}

template<class D>
void textAt(D&d,const char* s,int px,int py,uint16_t col,
            bool large=false) {
    d.setTextDatum(middle_center);
    d.setTextColor(col);
    if(large) d.setFont(&fonts::FreeSansBold18pt7b);
    else d.setFont(&fonts::FreeSansBold12pt7b);
    d.drawString(s,S((float)px),S((float)py));
}

template<class D>
void drawMap(D &d) {
    // Mini map is the actual course spline, hazards and cup position.
    d.fillRoundRect(S(113),S(72),S(68),S(106),S(16),rgb(9,50,44));
    const float len=game.holeZ+18.0f;
    auto mx=[&](float wx){return S(147.0f+clampf(wx*.67f,-28.f,28.f));};
    auto my=[&](float wz){return S(163.0f-78.f*clampf(wz/len,0.f,1.f));};
    for(int i=0;i<game.course().fairwayCount-1;++i) {
        const FairwayNode &a=game.course().path[i];
        const FairwayNode &b=game.course().path[i+1];
        int ya=my(a.z),yb=my(b.z);
        int ax=mx(a.x),bx=mx(b.x);
        d.fillTriangle(ax-S(a.halfWidth*.57f),ya,ax+S(a.halfWidth*.57f),ya,
                       bx-S(b.halfWidth*.57f),yb,rgb(36,144,75));
        d.fillTriangle(ax+S(a.halfWidth*.57f),ya,bx-S(b.halfWidth*.57f),yb,
                       bx+S(b.halfWidth*.57f),yb,rgb(36,144,75));
    }
    if(game.course().terrain==RAVINE) {
        d.drawLine(S(119),my(game.course().ravineStart),S(175),my(game.course().ravineStart),rgb(224,166,92));
        d.drawLine(S(119),my(game.course().ravineEnd),S(175),my(game.course().ravineEnd),rgb(224,166,92));
    }
    for(int i=0;i<game.bunkerCount();++i) {
        const HazardEllipse b=game.bunker(i);
        d.fillCircle(mx(b.x),my(b.z),S(3),rgb(228,198,121));
    }
    for(int i=0;i<game.pondCount();++i) {
        const HazardEllipse p=game.pond(i);
        d.fillEllipse(mx(p.x),my(p.z),S(3+clampf(p.rx*.15f,0,3)),S(3+clampf(p.rz*.07f,0,3)),rgb(23,147,214));
    }
    d.fillCircle(mx(game.holeX),my(game.holeZ),S(5),rgb(74,200,107));
    d.fillCircle(mx(game.holeX),my(game.holeZ),S(2),cBlack);
    int px=mx(game.x),py=my(game.z);
    d.fillCircle(px,py,S(4),cWhite);
    d.drawCircle(px,py,S(6),cGold);
}

template<class D>
void drawWind(D& d) {
    d.fillRoundRect(S(184),S(82),S(83),S(92),S(16),rgb(8,52,62));
    textAt(d,"WIND",225,99,rgb(194,239,242));
    // Arrow represents the direction wind is BLOWING, projected into the
    // player's current horizon (right/up on screen = world right/forward).
    const float side=game.windX*game.aimZ-game.windZ*game.aimX;
    const float front=game.windX*game.aimX+game.windZ*game.aimZ;
    float len=length2(side,front);
    float dx=len>.01f ? side/len : 1.0f;
    float dy=len>.01f ? -front/len : 0.0f;
    int xc=S(225),yc=S(131),reach=S(15);
    int x2=xc+(int)(dx*reach),y2=yc+(int)(dy*reach);
    uint16_t col=rgb(121,231,247);
    d.drawLine(xc-(int)(dx*S(9)),yc-(int)(dy*S(9)),x2,y2,col);
    d.fillTriangle(x2,y2,x2-(int)((dx*.75f-dy*.65f)*S(9)),
                   y2-(int)((dy*.75f+dx*.65f)*S(9)),
                   x2-(int)((dx*.75f+dy*.65f)*S(9)),
                   y2-(int)((dy*.75f-dx*.65f)*S(9)),col);
    char tmp[24];
    snprintf(tmp,sizeof(tmp),"%.1fm/s",game.windSpeed());
    textAt(d,tmp,225,159,cWhite);
}

template<class D>
void drawTournamentFinal(D& d) {
    // Complete nine-hole scorecard. Each row shows the actual score recorded
    // on cup-in, the par from that hole's course layout, and their difference.
    // Water/ravine +2 penalties are already included in game.shots.
    d.fillScreen(rgb(5,26,31));
    d.drawCircle(S(233),S(233),S(221),rgb(97,183,172));
    textAt(d,"9-HOLE SCORECARD",233,66,cGold,true);
    textAt(d,"TOURNAMENT RESULTS",233,106,rgb(185,232,218));

    const uint16_t labelColor=rgb(169,214,215);
    d.fillRoundRect(S(74),S(122),S(318),S(28),S(9),rgb(11,56,60));
    textAt(d,"HOLE",115,136,labelColor);
    textAt(d,"PAR",193,136,labelColor);
    textAt(d,"SHOT",281,136,labelColor);
    textAt(d,"+/-",362,136,labelColor);

    char tmp[24];
    for(int i=0; i<kHoleCount; ++i) {
        const int y=164+i*25;
        const int par=kNineHoles[i].par;
        const int strokes=holeScores[i];
        const int delta=strokes-par;
        const uint16_t scoreColor=delta<0 ? rgb(115,230,184) :
                                  delta>0 ? rgb(250,185,140) : cWhite;
        d.fillRoundRect(S(73),S(y-12),S(320),S(24),S(6),
                        (i&1) ? rgb(9,39,45) : rgb(14,48,53));
        snprintf(tmp,sizeof(tmp),"%d",i+1);
        textAt(d,tmp,115,y,cWhite);
        snprintf(tmp,sizeof(tmp),"%d",par);
        textAt(d,tmp,193,y,labelColor);
        snprintf(tmp,sizeof(tmp),"%d",strokes);
        textAt(d,tmp,281,y,cWhite);
        if(delta==0) snprintf(tmp,sizeof(tmp),"E");
        else snprintf(tmp,sizeof(tmp),"%+d",delta);
        textAt(d,tmp,362,y,scoreColor);
    }

    const int totalDelta=completedStrokes-completedPar;
    d.drawLine(S(76),S(381),S(389),S(381),rgb(79,160,154));
    textAt(d,"TOTAL",115,401,cGold);
    snprintf(tmp,sizeof(tmp),"%d",completedPar);
    textAt(d,tmp,193,401,cGold);
    snprintf(tmp,sizeof(tmp),"%d",completedStrokes);
    textAt(d,tmp,281,401,cGold);
    if(totalDelta==0) snprintf(tmp,sizeof(tmp),"E");
    else snprintf(tmp,sizeof(tmp),"%+d",totalDelta);
    textAt(d,tmp,362,401,cGold);
    textAt(d,"TAP / L / R",233,428,rgb(181,234,219));
    textAt(d,"RESTART",233,450,rgb(181,234,219));
}

template<class D>
void drawCupHUD(D& d) {
    if(tournamentFinished) {drawTournamentFinal(d);return;}
    char tmp[70];
    d.fillRoundRect(S(72),S(334),S(322),S(114),S(22),rgb(8,35,34));
    snprintf(tmp,sizeof(tmp),"HOLE %d/9 COMPLETE",currentHole+1);
    textAt(d,tmp,233,356,cGold,true);
    const int delta=game.shots-game.holePar;
    snprintf(tmp,sizeof(tmp),"%d STROKES  PAR %d  (%+d)",game.shots,game.holePar,delta);
    textAt(d,tmp,233,388,cWhite);
    textAt(d,"TAP / L / R NEXT",233,423,rgb(194,238,221));
}

template<class D>
void drawLongDriveResult(D& d) {
    d.fillScreen(rgb(5,30,43));
    d.drawCircle(S(233),S(233),S(220),rgb(84,178,205));
    textAt(d,"LONG DRIVE",233,81,cGold,true);
    char tmp[80];
    snprintf(tmp,sizeof(tmp),"ATTEMPT %d / %d",driveAttempt,DRIVE_ATTEMPTS);
    textAt(d,tmp,233,128,cWhite);
    float result=driveDistances[driveAttempt-1];
    if(result<=0.001f) textAt(d,"WATER - VOID",233,191,cWhite,true);
    else {snprintf(tmp,sizeof(tmp),"%.1f m",result);textAt(d,tmp,233,191,cWhite,true);}
    snprintf(tmp,sizeof(tmp),"BEST %.1f m",bestDrive);
    textAt(d,tmp,233,257,cGold,true);
    if(driveFinished) {
        textAt(d,"3 ATTEMPTS FINISHED",233,325,cWhite);
        textAt(d,"TAP / R RESTART",233,406,rgb(198,237,235));
    } else {
        textAt(d,"TAP / R NEXT BALL",233,386,rgb(198,237,235));
    }
    textAt(d,"L BUTTON: SETTINGS",233,435,rgb(170,211,220));
}

template<class D>
void drawAimArrows(D& d) {
    // Draw controls inside the round glass, away from the strike/power pad.
    const uint16_t bg=rgb(9,48,59), edge=rgb(92,207,211);
    const int cy=S(236), left=S(57), right=S(409), radius=S(33);
    d.fillCircle(left,cy,radius,bg);
    d.drawCircle(left,cy,radius,edge);
    d.fillCircle(right,cy,radius,bg);
    d.drawCircle(right,cy,radius,edge);
    // Bold, font-independent arrows visible on the AMOLED.
    const uint16_t ink=cWhite;
    d.fillRect(left-S(3),cy-S(5),S(22),S(10),ink);
    d.fillTriangle(left-S(19),cy,left+S(2),cy-S(19),left+S(2),cy+S(19),ink);
    d.fillRect(right-S(19),cy-S(5),S(22),S(10),ink);
    d.fillTriangle(right+S(19),cy,right-S(2),cy-S(19),right-S(2),cy+S(19),ink);
    // Signed direction relative to the cup; orientation affects actual shot.
    d.fillRoundRect(S(135),S(281),S(196),S(37),S(12),rgb(9,35,49));
    char bearing[32];
    snprintf(bearing,sizeof(bearing),"AIM %+d DEG",
             (int)lroundf(game.aimOffset * (180.0f/3.141592653589793f)));
    textAt(d,bearing,233,299,cGold);
}

template<class D>
void drawWaterHUD(D&d) {
    d.fillRoundRect(S(72),S(53),S(322),S(99),S(22),rgb(6,47,69));
    textAt(d,game.ravineSink?"RAVINE":"WATER HAZARD",233,84,cWhite,true);
    textAt(d,game.ravineSink?"FALLING - LOOK UP":"SINKING - LOOK UP",233,124,rgb(181,235,241));
    d.fillRoundRect(S(92),S(326),S(282),S(111),S(20),rgb(6,40,56));
    textAt(d,"PENALTY +2",233,353,cGold,true);
    textAt(d,"RESUME PLAY",233,391,cWhite,true);
    textAt(d,"RETURN TO LAST LIE",233,423,rgb(183,224,226));
}

template<class D>
void drawHUD(D&d) {
    if(game.state==State::HOLED) { drawCupHUD(d); return; }
    if(game.state==State::SINKING) { drawWaterHUD(d); return; }
    char tmp[64];
    d.fillRoundRect(S(100),S(14),S(266),S(42),S(18),rgb(9,35,49));
    if(mode==GameMode::TOURNAMENT) {
        snprintf(tmp,sizeof(tmp),"H%d/9 %s",currentHole+1,game.course().name);
        textAt(d,tmp,233,34,cWhite,false);
    } else {
        snprintf(tmp,sizeof(tmp),"DRACON  TRY %d/3",driveResult?driveAttempt:driveAttempt+1);
        textAt(d,tmp,233,34,cWhite,false);
    }
    textAt(d,"L MENU  R SHOT",233,64,rgb(200,239,226));
    drawMap(d);
    drawWind(d);
    d.fillRoundRect(S(270),S(75),S(97),S(106),S(22),rgb(9,43,54));
    if(mode==GameMode::TOURNAMENT) {
        snprintf(tmp,sizeof(tmp),"PAR %d",game.holePar);
    } else snprintf(tmp,sizeof(tmp),"BEST");
    textAt(d,tmp,318,93,rgb(242,216,127));
    if(mode==GameMode::TOURNAMENT)
        snprintf(tmp,sizeof(tmp),"%.0fm",game.distance);
    else
        snprintf(tmp,sizeof(tmp),"%.0fm",bestDrive);
    textAt(d,tmp,318,124,cWhite,true);
    if(mode==GameMode::TOURNAMENT)
        snprintf(tmp,sizeof(tmp),"SHOT %d",game.shots+((game.state==State::READY)?1:0));
    else
        snprintf(tmp,sizeof(tmp),"TRY %d",driveAttempt+(game.state==State::READY?1:0));
    textAt(d,tmp,318,156,cWhite);
    if(game.inSand()) {
        d.fillRoundRect(S(151),S(182),S(166),S(31),S(10),rgb(92,75,29));
        textAt(d,"BUNKER LIE",233,196,cWhite);
    }
    if(game.state==State::READY && lastWaterResetAtMs &&
        uint32_t(millis()-lastWaterResetAtMs)<3200u) {
        d.fillRoundRect(S(128),S(213),S(210),S(44),S(14),rgb(15,64,80));
        textAt(d,"RESUME +2 STROKES",233,233,cWhite);
    }

    // Aim controls are only active while preparing the next stroke.
    if(game.state==State::READY) drawAimArrows(d);

    // Touch only adjusts the impact point. The right physical button shoots;
    // the power meter itself cannot trigger a shot.
    if(game.state==State::READY) {
        d.fillRoundRect(S(109),S(325),S(249),S(106),S(36),rgb(9,35,45));
        textAt(d,"IMPACT",165,344,rgb(230,237,212));
        d.fillCircle(S(165),S(382),S(28),rgb(244,246,232));
        d.drawCircle(S(165),S(382),S(28),rgb(123,158,150));
        d.drawLine(S(143),S(382),S(187),S(382),rgb(143,161,157));
        d.drawLine(S(165),S(361),S(165),S(403),rgb(143,161,157));
        d.fillCircle(S(165)+S(game.hitSide*21),S(382),S(8),rgb(255,83,63));
        d.drawCircle(S(165)+S(game.hitSide*21),S(382),S(8),cBlack);

        int meterTop=348, meterH=59;
        d.fillRoundRect(S(252),S(meterTop-4),S(48),S(meterH+8),S(9),rgb(44,82,86));
        int active=(int)(game.currentPower * meterH);
        d.fillRect(S(259),S(meterTop+meterH-active),S(34),S(active),
            game.currentPower > .75f ? rgb(234,101,63) :
            (game.currentPower > .40f ? rgb(242,207,81):rgb(99,203,114)));
        d.drawRect(S(259),S(meterTop),S(34),S(meterH),cWhite);
        textAt(d,"PWR",327,359,cWhite);
        textAt(d,"RIGHT",327,388,cGold);
        textAt(d,"BTN",327,416,cWhite);
    } else {
        // A high-contrast flight/roll readout, all inside the round screen.
        d.fillRoundRect(S(111),S(329),S(244),S(99),S(24),rgb(10,45,56));
        if (game.state==State::AIRBORNE) {
            textAt(d,"IN FLIGHT",233,351,cGold);
            snprintf(tmp,sizeof(tmp),"ALT %.1f m",fmaxf(0.0f,game.y));
            textAt(d,tmp,233,380,cWhite,true);
            const float speed=sqrtf(game.vx*game.vx+game.vy*game.vy+game.vz*game.vz);
            snprintf(tmp,sizeof(tmp),"SPEED %.1f m/s",speed);
            textAt(d,tmp,233,410,rgb(206,240,233));
        } else {
            textAt(d,game.inSand()?"IN BUNKER":
                     (game.onGreen()?"ON THE GREEN":"ROLLING"),
                     233,354,cGold);
            const float speed=length2(game.vx,game.vz);
            snprintf(tmp,sizeof(tmp),"ROLL %.1f m/s",speed);
            textAt(d,tmp,233,387,cWhite,true);
            snprintf(tmp,sizeof(tmp),"TO CUP %.1f m",game.distance);
            textAt(d,tmp,233,414,rgb(206,240,233));
        }
    }
}

template<class D>
void drawShotFeedback(D& d) {
    if (lastShotAtMs == 0 || game.state==State::HOLED || game.state==State::READY) return;
    const uint32_t now=millis();
    // Keep the selected meter strength and hit point visible after firing.
    // These are snapshots: the power meter keeps oscillating in the physics core.
    if (uint32_t(now-lastShotAtMs)<1450u) {
        d.fillRoundRect(S(95),S(206),S(276),S(72),S(17),rgb(9,35,49));
        char msg[54];
        snprintf(msg,sizeof(msg),"SHOT %d  POWER %d%%",game.shots,
                 (int)lroundf(lastShotPower*100.f));
        textAt(d,msg,233,227,cGold);
        const char* side=lastShotImpact<-.04f?"LEFT":(lastShotImpact>.04f?"RIGHT":"CENTER");
        snprintf(msg,sizeof(msg),"IMPACT %s %d%%",side,
                 (int)lroundf(fabsf(lastShotImpact)*100.f));
        textAt(d,msg,233,259,cWhite);
    } else if (lastLandingAtMs && uint32_t(now-lastLandingAtMs)<850u) {
        d.fillRoundRect(S(132),S(213),S(202),S(48),S(17),rgb(12,57,40));
        textAt(d,"LANDED",233,237,cGold,true);
    }
}

template<class D>
void drawSettings(D &d) {
    d.fillScreen(rgb(4,18,31));
    d.drawCircle(S(233),S(233),S(222),rgb(69,129,137));
    textAt(d,"SETTINGS",233,61,cGold,true);
    textAt(d,"LEFT BUTTON: CLOSE",233,94,rgb(178,226,228));
    auto item=[&](int row, const char* label, uint16_t color) {
        const int cy=kMenuRowY[row];
        d.fillRoundRect(S(107),S(cy-kMenuRowHalf),S(252),S(kMenuRowHalf*2),S(12),rgb(18,64,79));
        d.drawRoundRect(S(107),S(cy-kMenuRowHalf),S(252),S(kMenuRowHalf*2),S(12),color);
        textAt(d,label,233,cy,color);
    };
    char label[50];
    item(0,mode==GameMode::TOURNAMENT?"TOURNAMENT 9H *":"TOURNAMENT 9H",cGold);
    item(1,mode==GameMode::LONG_DRIVE?"DRACON 3 BALLS *":"DRACON 3 BALLS",cGold);
    snprintf(label,sizeof(label),"AIM STEP  %d DEG",settingsAimStep);
    item(2,label,cWhite);
    item(3,settingsAutoAimToCup?"AUTO CUP  ON":"AUTO CUP  OFF",cGold);
    item(4,settingsSound?"SOUND  ON":"SOUND  OFF",cWhite);
    item(5,settingsVibration?"VIBRATION  ON":"VIBRATION  OFF",cWhite);
    item(6,"CLOSE",cWhite);
}

template<class D>
void render(D &d) {
    if(menuOpen) { drawSettings(d); return; }
    if(mode==GameMode::TOURNAMENT && tournamentFinished && game.state==State::HOLED) {
        drawTournamentFinal(d);return;
    }
    if(mode==GameMode::LONG_DRIVE && driveResult) {
        drawLongDriveResult(d);return;
    }
    drawWorld(d);
    drawHUD(d);
    drawShotFeedback(d);
}

static void presentGame() {
    if (haveScene) {
        // The destination must finish reading PSRAM before we repaint it.
        M5.Display.waitDMA();
        render(scene);
        scene.pushSprite((screenW - SCENE_SIDE)/2, (screenH - SCENE_SIDE)/2);
        M5.Display.waitDMA();
    } else {
        // Safe fallback when PSRAM allocation fails. Keep the panel-owned
        // initialization unchanged and do not dereference a failed sprite.
        M5.Display.startWrite();
        render(M5.Display);
        M5.Display.endWrite();
    }
}


void resetForCurrentHole() {
    game.setHole(mode==GameMode::TOURNAMENT?currentHole:5);
    if(!settingsAutoAimToCup) game.setAutoAimToCup(false,true);
    refreshFairway();
    game.setWindSeed(++windRound*0x9E3779B9u+micros());
    if(vibrationEnabled) {M5.Power.setVibration(0);vibrationEnabled=false;}
    pendingToneAt=vibrationUntil=0;
    queuedClubSound=nullptr; queuedClubRetries=0;
    physicsCarry=0;
    lastPhysicsUs=micros();
    forceDraw=true;
    lastShotAtMs=lastLandingAtMs=lastWaterResetAtMs=0;
    lastShotPower=lastShotImpact=0.f;
}
void newGame() {
    currentHole=0;
    completedStrokes=completedPar=0;
    tournamentFinished=false;
    for(int &s:holeScores)s=0;
    for(float &d:driveDistances)d=0;
    bestDrive=0;
    driveAttempt=0;
    driveResult=driveFinished=false;
    driveTouchWasDown=false;
    resetForCurrentHole();
    // Do not reset gesture here: a replay touch remains captured until release.
}
void selectMode(GameMode selected) {
    mode=selected;
    newGame();
    menuOpen=false;
    gesture.reset();
    menuTouchWasDown=true;
    forceDraw=true;
}
void finishDrive(float distance) {
    if(driveResult || driveAttempt<1 || driveAttempt>DRIVE_ATTEMPTS)return;
    driveDistances[driveAttempt-1]=distance;
    if(distance>bestDrive)bestDrive=distance;
    driveResult=true;
    driveFinished=(driveAttempt==DRIVE_ATTEMPTS);
    game.vx=game.vy=game.vz=0;
    if(game.state!=State::HOLED) game.state=State::READY;
    forceDraw=true;
}
void nextDrive() {
    if(driveFinished) {newGame();return;}
    driveResult=false;
    resetForCurrentHole();
    gesture.reset();
}
void recordCup() {
    if(mode!=GameMode::TOURNAMENT || tournamentFinished)return;
    holeScores[currentHole]=game.shots;
    completedStrokes+=game.shots;
    completedPar+=game.holePar;
    if(currentHole==kHoleCount-1) tournamentFinished=true;
}
void advanceTournament() {
    if(tournamentFinished) {newGame();return;}
    if(currentHole < kHoleCount-1) ++currentHole;
    resetForCurrentHole();
    gesture.reset();
}
void fire() {
    const float chosenPower=game.currentPower;
    const float chosenImpact=game.hitSide;
    if(game.shoot()) {
        lastShotPower=chosenPower;
        lastShotImpact=chosenImpact;
        lastShotAtMs=millis();
        lastLandingAtMs=0;
        if(mode==GameMode::LONG_DRIVE) {
            ++driveAttempt;
            driveTeeX=game.prevShotX;driveTeeZ=game.prevShotZ;
            // Each of the three attempts is a driver shot.
            shotFX(false,true);
        } else {
            // One driver's first shot for every new hole, as intended.
            shotFX(game.lastWasPutt,game.shots==1);
        }
        forceDraw=true;
    }
}
void input() {
    auto td=M5.Touch.getDetail();
    const bool down=td.isPressed();
    // A completed hole accepts touch or EITHER physical button.
    // It is processed ahead of normal L=settings / R=shot.
    if(mode==GameMode::TOURNAMENT && game.state==State::HOLED) {
        if(M5.BtnA.wasPressed() || M5.BtnB.wasPressed()) {
            advanceTournament();return;
        }
        const TouchTarget a=gesture.update(down,td.x/unitScale,td.y/unitScale,
                                            true,game.hitSide);
        if(a==TouchTarget::REPLAY) advanceTournament();
        return;
    }
    // Menu remains available with the left button even on drive results.
    if(M5.BtnA.wasPressed()) {
        menuOpen=!menuOpen;
        menuTouchWasDown=down;
        gesture.reset();
        (void)M5.BtnB.wasPressed();
        physicsCarry=0;
        lastPhysicsUs=micros();
        forceDraw=true;
        return;
    }
    if(menuOpen) {
        (void)M5.BtnB.wasPressed();
        if(!down) {menuTouchWasDown=false;return;}
        if(menuTouchWasDown)return;
        menuTouchWasDown=true;
        const int row=menuRowAt(td.x/unitScale,td.y/unitScale);
        if(row==0) {selectMode(GameMode::TOURNAMENT);return;}
        if(row==1) {selectMode(GameMode::LONG_DRIVE);return;}
        if(row==2) {
            settingsAimStep=settingsAimStep==5?10:(settingsAimStep==10?1:5);
        } else if(row==3) {
            settingsAutoAimToCup=!settingsAutoAimToCup;
            game.setAutoAimToCup(settingsAutoAimToCup);
        } else if(row==4) {
            settingsSound=!settingsSound;
            if(!settingsSound){pendingToneAt=0;queuedClubSound=nullptr;}
            else primeGolfSpeaker();
        } else if(row==5) {
            settingsVibration=!settingsVibration;
            if(!settingsVibration&&vibrationEnabled) {
                M5.Power.setVibration(0);
                vibrationEnabled=false;vibrationUntil=0;
            }
        } else if(row==6) {
            menuOpen=false;
            gesture.reset();
        }
        forceDraw=true;
        return;
    }
    if(mode==GameMode::LONG_DRIVE && driveResult) {
        const bool right=M5.BtnB.wasPressed();
        const bool freshTouch=down&&!driveTouchWasDown;
        driveTouchWasDown=down;
        if(right||freshTouch)nextDrive();
        return;
    }
    // Right physical key alone initiates a shot.
    if(M5.BtnB.wasPressed() && game.state==State::READY) {fire();return;}
    const float ux=td.x/unitScale, uy=td.y/unitScale;
    TouchTarget a=gesture.update(down,ux,uy,false,game.hitSide);
    if(a==TouchTarget::AIM_LEFT&&game.state==State::READY) {
        game.steerAim(-1,settingsAimStep);forceDraw=true;
    } else if(a==TouchTarget::AIM_RIGHT&&game.state==State::READY) {
        game.steerAim(1,settingsAimStep);forceDraw=true;
    }
}
} // namespace

static void golfLoopOnce() {
    if (!displayReady) { delay(1000); return; }
    // Input and hardware events are serviced every pass, independent of display.
    M5.update();
    input();
    if(menuOpen) {
        // No time accumulated while settings are visible.
        lastPhysicsUs=micros();
        physicsCarry=0;
        updateFX();
        uint32_t now=millis();
        if(forceDraw || uint32_t(now-lastDraw)>=180u) {
            lastDraw=now;
            presentGame();
            forceDraw=false;
        }
        delay(10);
        return;
    }
    uint32_t currentUs=micros();
    float elapsed=float(uint32_t(currentUs-lastPhysicsUs))*0.000001f;
    lastPhysicsUs=currentUs;
    // A slow LCD transfer must not translate into a large unstable physics step.
    physicsCarry += clampf(elapsed,0.0f,0.12f);
    uint8_t events=0;
    int steps=0;
    while (physicsCarry >= FIXED_DT && steps < 15) {
        events |= game.step(FIXED_DT);
        physicsCarry -= FIXED_DT;
        ++steps;
    }
    if (steps==15 && physicsCarry>FIXED_DT) physicsCarry=0;
    if (events & LANDING) { lastLandingAtMs=millis(); landingFX(); }
    if (events & CUP) {
        cupFX();
        if(mode==GameMode::TOURNAMENT)recordCup();
        else finishDrive(length2(game.x-driveTeeX,game.z-driveTeeZ));
    }
    if (events & (WATER_HIT|RAVINE_HIT)) {
        lastLandingAtMs=0;
        pendingToneAt=0;
        sound(170,220);
        buzz(100,100);
        forceDraw=true;
    }
    if (events & WATER_RESET) {
        lastWaterResetAtMs=millis();
        if(mode==GameMode::LONG_DRIVE)finishDrive(0.0f);
        forceDraw=true;
    }
    if (events & STOP) {
        if(mode==GameMode::LONG_DRIVE)
            finishDrive(length2(game.x-driveTeeX,game.z-driveTeeZ));
        forceDraw=true;
    }
    if(events & TREE_HIT) {sound(360,35); forceDraw=true;}
    updateFX();
    uint32_t now=millis();
    // Draw the settled cup view exactly once; keep power meter gently animated
    // before the shot, and use a higher target refresh while the ball is moving.
    const bool finished=(game.state==State::HOLED);
    const uint32_t interval=(game.state==State::AIRBORNE ? 32 :
                              game.state==State::ROLLING ? 36 :
                              game.state==State::SINKING ? 35 : 48);
    if ((!finished || forceDraw || lastDrawnState!=game.state) &&
        (forceDraw || uint32_t(now-lastDraw)>=interval)) {
        // Frame cadence is measured between frame STARTS, including draw time.
        // A slow upload does not add a full extra interval of idle time.
        lastDraw=now;
        // R16F5 PSRAM sprite path with waitDMA fences; fallback is direct.
        presentGame();
        lastDrawnState=game.state;
        forceDraw=false;
    }
    delay(1);
}

// Game entry invoked by the application startup.
// M5.begin() is called once by our own src/main.cpp before this entry.
namespace balls_eye_golf {
void begin() {
    displayReady = true;
    screenW = M5.Display.width();
    screenH = M5.Display.height();
    unitScale = float(screenW) / 466.0f;
    precomputeScene();
    newGame();
    // First frame: draw the game screen directly.
    M5.Display.startWrite();
    render(M5.Display);
    M5.Display.endWrite();
    scene.setColorDepth(16);
    scene.setPsram(true);
    haveScene = (scene.createSprite(SCENE_SIDE, SCENE_SIDE) != nullptr);
    if (haveScene) presentGame();
    // Speaker wake-up happens after the visible title and the first golf draw.
    primeGolfSpeaker();
    lastPhysicsUs = micros();
    lastDraw = millis();
    // Return to Arduino so the normal loop() can service the game each frame.
}

void update() {
    golfLoopOnce();
}
}
